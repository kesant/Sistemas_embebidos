#include <avr/io.h>
#include <util/delay.h>
#define F_CPU 8000000



int main(void)
{
	
	DDRB = 0xFF;
	DDRD = 0xFF; // Inicializando los puertos B y D como salidas
	
	char PORT[8] = {1,2,4,8,16,32,64,128}; // valores de los pines PORTD
	
	char MENSAJE[]={0x0, 0x0, 0x4e, 0x4a, 0x7a, 0x7e, 0x0, 0x0, //9
		0x0, 0x0, 0x7e, 0x5a, 0x5a, 0x7e, 0x0, 0x0, //8
		0x0, 0x0, 0x06, 0x06, 0x7e, 0x7e, 0x0, 0x0, //7
		0x0, 0x0, 0x7e, 0x4e, 0x7a, 0x7a, 0x0, 0x0, //6
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	0x0, 0x0, 0x0, 0x0, 0x0, 0x0, 0x0, 0x0
	}; //ESPACIO
	
	while (1)
	{
		int cont=0;
		for (int i=0;i<15;i++)//
		{
			
			for (int k=0;k<50;k++)//
			{
				for (int j=0; j<8;j++)//
				{
					
					PORTD = PORT[j];
					PORTB = ~MENSAJE[j+cont];
					_delay_ms(1);// delay para que se muestre en la matriz sin parpadeos
				}
				
			}
			cont=cont+8;
		}

	}
}